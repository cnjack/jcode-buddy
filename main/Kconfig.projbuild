## main/Kconfig.projbuild
```kconfig
menu "ASR Configuration"

    config ASR_API_KEY
        string "Alibaba Qwen ASR API Key"
        default "sk-d5909eea0141485583d38b754c982068"
        help
            API key for Alibaba DashScope Qwen3-ASR-Flash-Realtime service.

endmenu
```

## sdkconfig.defaults
```kconfig
# ESP-IDF default configuration for 流光 Smart Desktop Companion
CONFIG_IDF_TARGET="esp32s3"
CONFIG_ESPTOOLPY_FLASHSIZE_16MB=y
CONFIG_PARTITION_TABLE_CUSTOM=y
CONFIG_PARTITION_TABLE_CUSTOM_FILENAME="partitions.csv"
CONFIG_COMPILER_OPTIMIZATION_SIZE=y

# PSRAM (Octal, 80MHz)
CONFIG_SPIRAM=y
CONFIG_SPIRAM_MODE_OCT=y
CONFIG_SPIRAM_SPEED_80M=y
CONFIG_SPIRAM_MALLOC_ALWAYSINTERNAL=4096
CONFIG_SPIRAM_MALLOC_RESERVE_INTERNAL=65536

# LVGL
CONFIG_LV_OS_FREERTOS=y
CONFIG_LV_ATTRIBUTE_FAST_MEM_USE_IRAM=y
CONFIG_LV_FONT_MONTSERRAT_12=y
CONFIG_LV_FONT_MONTSERRAT_14=y
CONFIG_LV_FONT_MONTSERRAT_16=y
CONFIG_LV_FONT_MONTSERRAT_20=y
CONFIG_LV_FONT_MONTSERRAT_48=y
CONFIG_LV_TXT_BREAK_CHARS=" ,.;:-_"
CONFIG_LV_USE_SNAPSHOT=y
CONFIG_LV_FONT_SOURCE_HAN_SANS_SC_16_CJK=y
CONFIG_LV_FONT_SOURCE_HAN_SANS_SC_14_CJK=y

# FreeRTOS
CONFIG_FREERTOS_HZ=1000

# FAT filesystem
CONFIG_FATFS_LFN_HEAP=y
CONFIG_FATFS_SECTOR_512=y

# Bluetooth — NimBLE (BLE-only, for NUS)
CONFIG_BT_ENABLED=y
CONFIG_BT_NIMBLE_ENABLED=y
CONFIG_BT_CONTROLLER_ENABLED=y
CONFIG_BT_NIMBLE_MAX_CONNECTIONS=3
CONFIG_BT_NIMBLE_ATT_PREFERRED_MTU=247

# WiFi + BLE co-existence
CONFIG_ESP_COEX_SW_COEXIST_ENABLE=y

# Reduce WiFi buffers to share internal SRAM with BLE
CONFIG_ESP_WIFI_STATIC_RX_BUFFER_NUM=4
CONFIG_ESP_WIFI_DYNAMIC_RX_BUFFER_NUM=16
CONFIG_ESP_WIFI_RX_BA_WIN=6
# Static TX count reduced (each ~1.6KB internal SRAM; 16→4 saves ~19KB)
CONFIG_ESP_WIFI_STATIC_TX_BUFFER_NUM=4
CONFIG_ESP_WIFI_CACHE_TX_BUFFER_NUM=4
# RX management: dynamic
CONFIG_ESP_WIFI_DYNAMIC_RX_MGMT_BUFFER=y
# Move WiFi/LwIP dynamic allocations to PSRAM
CONFIG_SPIRAM_TRY_ALLOCATE_WIFI_LWIP=y

# HTTP client
CONFIG_ESP_HTTP_CLIENT_ENABLE_HTTPS=y

# WebSocket client (for ASR)
CONFIG_WEBSOCKET_URI_FROM_STRING=y

# mbedTLS — certificate bundle for WSS connections
CONFIG_MBEDTLS_CERTIFICATE_BUNDLE=y
CONFIG_MBEDTLS_CERTIFICATE_BUNDLE_DEFAULT_FULL=y

# mbedTLS — memory optimization for TLS on ESP32-S3
CONFIG_MBEDTLS_DYNAMIC_BUFFER=y
CONFIG_MBEDTLS_DYNAMIC_FREE_PEER_CERT=y
CONFIG_MBEDTLS_DYNAMIC_FREE_CONFIG_DATA=y
CONFIG_MBEDTLS_ASYMMETRIC_CONTENT_LEN=y
CONFIG_MBEDTLS_SSL_IN_CONTENT_LEN=4096
CONFIG_MBEDTLS_SSL_OUT_CONTENT_LEN=2048
CONFIG_MBEDTLS_DEFAULT_MEM_ALLOC=y
```
